## config/west.yml
```yaml
manifest:
  remotes:
    - name: zmkfirmware
      url-base: https://github.com/zmkfirmware
    # support nice_oled and nice_epaper
    - name: mctechnology17
      url-base: https://github.com/mctechnology17
    - name: m165437
      url-base: https://github.com/M165437
    - name: hecspc
      url-base: https://github.com/hecspc
  # Additional modules containing boards/shields/custom code can be listed here as well
  # See https://docs.zephyrproject.org/3.2.0/develop/west/manifest.html#projects
  projects:
    - name: zmk
      remote: zmkfirmware
      revision: df2e979d7e03ba84a503e3d90975a599d484b9e0
      import: app/west.yml
    # support nice_oled and nice_epaper
    - name: zmk-nice-oled
      remote: mctechnology17
      revision: 46f824abb2bd41f1287c5c68abd14122af6042a3
    - name: nice-view-gem
      remote: hecspc
      revision: 18084d4fae186d2d8d2d84dd53ac89dd0d307e37
  self:
    path: config
```
