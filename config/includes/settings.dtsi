
#if defined(NICE_VIEW_SPI)
&nice_view_spi {
    cs-gpios = <NICE_VIEW_SPI>;
};
#endif


&led_strip {
    chain-length = <6>;
};

// &sensors {
//     left_config {
//         triggers-per-rotation = <18>;
//     };
//
//     right_config {
//         triggers-per-rotation = <24>;
//     };
// };

&mt {
  tapping-term-ms = <240>;
};

&lt {  // layer-tap config
  flavor = "balanced";
  tapping-term-ms = <200>;
  quick-tap-ms = <175>;
};
